## arch/k1c/Kconfig
```kconfig
config K1C
	bool
	select HAS_KALLSYMS
	select HAS_MODULES
	select HAS_CACHE
	select GENERIC_FIND_NEXT_BIT
	select 64BIT
	default y

config PHYS_ADDR_T_64BIT
	bool

config 64BIT
	bool
	select PHYS_ADDR_T_64BIT
	default y

config ARCH_TEXT_BASE
	hex
	default 0x00000000

menu "Kalray specific"

config ARCHINFO
	string
	default "coolidge"

config SMEM_SIZE
	hex
	default 0x400000

config MALLOC_BASE
	hex
	default 0x80000000

config MALLOC_SIZE
	hex
	default 0x800000
	prompt "malloc area size"
endmenu

menu "Board configuration"

choice
	prompt "Select your board"

config GENERIC
	bool "Generic"
	select K1C

endchoice

endmenu
```

## arch/k1c/configs/generic_defconfig
```kconfig
CONFIG_DRIVER_SERIAL_K1C_SCALL=y
CONFIG_DRIVER_SERIAL_NS16550=y
CONFIG_BAUDRATE=38400
CONFIG_PINCTRL_SINGLE=y

CONFIG_CLOCKSOURCE_K1C=y
CONFIG_WATCHDOG=y
CONFIG_WATCHDOG_K1C=y
CONFIG_CMD_WD=y
CONFIG_CMD_FLASH=y
CONFIG_CMD_POWEROFF=y
CONFIG_CMD_OF_DUMP=y
CONFIG_RATP=y
CONFIG_CONSOLE_RATP=y

CONFIG_MTD=y
CONFIG_MTD_WRITE=y
CONFIG_MTD_SPI_NOR=y
CONFIG_MTD_SPI_NOR_USE_4K_SECTORS=y
CONFIG_SPI_SYNOPSYS_OCTALSPI_NOR=y
```

## arch/kvx/configs/fastboot_cv2_defconfig
```kconfig
CONFIG_AUTO_COMPLETE=y
CONFIG_BAUDRATE=115200
CONFIG_CLOCKSOURCE_KVX=y
CONFIG_DRIVER_SERIAL_KVX_SCALL=y
CONFIG_DRIVER_SERIAL_NS16550=y
CONFIG_GPIO_DESIGNWARE=y
CONFIG_MTD_SPI_NOR=y
CONFIG_MTD_WRITE=y
CONFIG_MTD=y
CONFIG_MCI=y
CONFIG_MCI_DWC_MSHC=y
CONFIG_MCI_STARTUP=y
CONFIG_PINCTRL_SINGLE=y
CONFIG_CONSOLE_RATP=y
CONFIG_RATP=y
CONFIG_SPI_SYNOPSYS_OCTALSPI_NOR=y
CONFIG_WATCHDOG_KVX=y
CONFIG_WATCHDOG=y
CONFIG_PARTITION_DISK_EFI=y

CONFIG_NVMEM=y
CONFIG_KVX_OTP_NV=y

#
# Architecture
#
CONFIG_ARCH_COOLIDGE_V2=y

#
# Logging
#
CONFIG_MEMINFO=n
CONFIG_BANNER=n
CONFIG_COMPILE_LOGLEVEL=6
CONFIG_DEFAULT_LOGLEVEL=5

CONFIG_GLOB=y
CONFIG_PARTITION=y

#
# USB
#
CONFIG_USB=y
CONFIG_USB_HOST=y
CONFIG_USB_DWC2=y
CONFIG_USB_DWC2_HOST=y
CONFIG_USB_DWC2_GADGET=y
CONFIG_USB_GADGET=y
CONFIG_USB_GADGET_FASTBOOT=y
CONFIG_USB_GADGET_SERIAL=y
CONFIG_CMD_USB=y
CONFIG_CMD_USBGADGET=y
CONFIG_GENERIC_PHY=y
CONFIG_USB_NOP_XCEIV=y

#
# Environment
#
CONFIG_ENV_HANDLING=n # must be disabled to force default environement to be used
CONFIG_DEFAULT_ENVIRONMENT=y
CONFIG_DEFAULT_COMPRESSION_NONE=y
CONFIG_DEFAULT_ENVIRONMENT_PATH="arch/kvx/boards/generic/dfu-env/"

#
# Commands
#
# Information
CONFIG_CMD_DMESG=y
CONFIG_LONGHELP=y
# Boot
CONFIG_CMD_BOOT=y
CONFIG_CMD_BOOTM=y
CONFIG_CMD_LOADY=y
CONFIG_CMD_RESET=y
# File
CONFIG_CMD_BASENAME=y
CONFIG_CMD_CAT=y
CONFIG_CMD_CD=y
CONFIG_CMD_CP=y
CONFIG_CMD_CMP=y
CONFIG_CMD_DIGEST=y
CONFIG_CMD_DIRNAME=y
CONFIG_CMD_FILETYPE=y
CONFIG_CMD_MKDIR=y
CONFIG_CMD_PWD=y
CONFIG_CMD_READLINK=y
CONFIG_CMD_RM=y
CONFIG_CMD_RMDIR=y
# Shell script
CONFIG_CMD_FALSE=y
CONFIG_CMD_GETOPT=y
CONFIG_CMD_TEST=y
CONFIG_CMD_TRUE=y
# Console
CONFIG_CMD_CLEAR=y
CONFIG_CMD_ECHO=y
CONFIG_CMD_ECHO_E=y
CONFIG_CMD_TIMEOUT=y
# Memory
CONFIG_CMD_MD=y
CONFIG_CMD_MEMCMP=y
CONFIG_CMD_MEMCPY=y
CONFIG_CMD_MEMSET=y
CONFIG_CMD_MW=y
# Hardware
CONFIG_CMD_POWEROFF=y
CONFIG_CMD_FLASH=y
CONFIG_CMD_WD=y
# Environment
CONFIG_CMD_EXPORT=y
# Misc
CONFIG_CMD_OF_DUMP=y
# Fastboot
CONFIG_FASTBOOT_CMD_OEM=y
```

## arch/kvx/configs/generic_defconfig
```kconfig
CONFIG_AUTO_COMPLETE=y
CONFIG_CONSOLE_RATP=y
CONFIG_PARTITION_DISK_EFI=y
CONFIG_STATE=y
CONFIG_BOOTCHOOSER=y
CONFIG_CMD_DMESG=y
CONFIG_LONGHELP=y
CONFIG_CMD_BOOT=y
CONFIG_CMD_RESET=y
CONFIG_CMD_NV=y
CONFIG_CMD_GLOBAL=y
CONFIG_CMD_LOADENV=y
CONFIG_CMD_PRINTENV=y
CONFIG_CMD_SAVEENV=y
CONFIG_CMD_CMP=y
CONFIG_CMD_FLASH=y
CONFIG_CMD_POWEROFF=y
CONFIG_CMD_USBGADGET=y
CONFIG_CMD_WD=y
CONFIG_CMD_OF_DUMP=y
CONFIG_CMD_STATE=y
CONFIG_DRIVER_SERIAL_KVX_SCALL=y
CONFIG_DRIVER_SERIAL_NS16550=y
CONFIG_MTD=y
CONFIG_MTD_SPI_NOR=y
CONFIG_SPI_SYNOPSYS_OCTALSPI_NOR=y
CONFIG_USB_HOST=y
CONFIG_USB_DWC2_HOST=y
CONFIG_USB_DWC2_GADGET=y
CONFIG_USB_GADGET=y
CONFIG_USB_GADGET_DFU=y
CONFIG_USB_GADGET_SERIAL=y
CONFIG_MCI=y
CONFIG_MCI_STARTUP=y
CONFIG_MCI_DWC_MSHC=y
CONFIG_CLOCKSOURCE_KVX=y
CONFIG_STATE_DRV=y
CONFIG_WATCHDOG=y
CONFIG_WATCHDOG_KVX=y
CONFIG_GPIO_DESIGNWARE=y
CONFIG_PINCTRL_SINGLE=y
CONFIG_GENERIC_PHY=y
CONFIG_USB_NOP_XCEIV=y
CONFIG_DIGEST_MD5_GENERIC=y
CONFIG_DIGEST_SHA256_GENERIC=y
CONFIG_CMD_TIMEOUT=y
```

## drivers/soc/kvx/Kconfig
```kconfig
menu "KVX SoC drivers"

config KVX_SOCINFO
        bool "KVX SoC Info driver"
	depends on KVX
	select NVMEM
	default y

endmenu
```
